## Documentation/devicetree/bindings/pinctrl/brcm,bcm2835-gpio.txt
```
Broadcom BCM2835 GPIO (and pinmux) controller

The BCM2835 GPIO module is a combined GPIO controller, (GPIO) interrupt
controller, and pinmux/control device.

Required properties:
- compatible: "brcm,bcm2835-gpio"
- reg: Should contain the physical address of the GPIO module's registers.
- gpio-controller: Marks the device node as a GPIO controller.
- #gpio-cells : Should be two. The first cell is the pin number and the
  second cell is used to specify optional parameters:
  - bit 0 specifies polarity (0 for normal, 1 for inverted)
- interrupts : The interrupt outputs from the controller. One interrupt per
  individual bank followed by the "all banks" interrupt.
- interrupt-controller: Marks the device node as an interrupt controller.
- #interrupt-cells : Should be 2.
  The first cell is the GPIO number.
  The second cell is used to specify flags:
    bits[3:0] trigger type and level flags:
      1 = low-to-high edge triggered.
      2 = high-to-low edge triggered.
      4 = active high level-sensitive.
      8 = active low level-sensitive.
    Valid combinations are 1, 2, 3, 4, 8.
- brcm,slew-rate: Array, representing the slew rate limit to apply to the bank:
  0: slew rate slow (limited)
  1: slew rate fast (not limited)
- brcm,input-schmitt-enable
- brcm,input-schmitt-disable
- brcm,drive-strength: Integer, representing the drive strength in mA
  Possible values: 2, 4, 6, 8, 10, 12, 14, 16

Please refer to ../gpio/gpio.txt for a general description of GPIO bindings.

Please refer to pinctrl-bindings.txt in this directory for details of the
common pinctrl bindings used by client devices, including the meaning of the
phrase "pin configuration node".

Each pin configuration node lists the pin(s) to which it applies, and one or
more of the mux function to select on those pin(s), and pull-up/down
configuration. Each subnode only affects those parameters that are explicitly
listed. In other words, a subnode that lists only a mux function implies no
information about any pull configuration. Similarly, a subnode that lists only
a pul parameter implies no information about the mux function.

Required subnode-properties:
- brcm,pins: An array of cells. Each cell contains the ID of a pin. Valid IDs
  are the integer GPIO IDs; 0==GPIO0, 1==GPIO1, ... 53==GPIO53.

Optional subnode-properties:
- brcm,function: Integer, containing the function to mux to the pin(s):
  0: GPIO in
  1: GPIO out
  2: alt5
  3: alt4
  4: alt0
  5: alt1
  6: alt2
  7: alt3
- brcm,pull: Integer, representing the pull-down/up to apply to the pin(s):
  0: none
  1: down
  2: up

Each of brcm,function and brcm,pull may contain either a single value which
will be applied to all pins in brcm,pins, or 1 value for each entry in
brcm,pins.

Example:

	pads@7e10002c {
		compatible = "brcm,bcm2835-pm-pads";
		reg = <0x7e10002c 0x18>;
		brcm,slew-rate = <3 1>;
		brcm,input-schmitt-enable = <3>;
		brcm,drive-strength = <3 8>;
	}

	gpio: gpio {
		compatible = "brcm,bcm2835-gpio";
		reg = <0x2200000 0xb4>;
		interrupts = <2 17>, <2 19>, <2 18>, <2 20>;

		gpio-controller;
		#gpio-cells = <2>;

		interrupt-controller;
		#interrupt-cells = <2>;
	};
```

## Documentation/devicetree/bindings/thermal/brcm,bcm2711-thermal.txt
```
Binding for Thermal Sensor driver for BCM2711 SoCs.

Required properties:
- compatible:		must be: "brcm,bcm2711-thermal"
- reg:			Address range of the thermal registers.
- clocks:		Phandle of the clock used by the thermal sensor.
- #thermal-sensor-cells:	should be 0 (see thermal.txt)

Optional properties:
- interrupts: temperature monitor interrupt
- interrupt-names: should be "tmon"

Example:

thermal-zones {
	cpu_thermal: cpu-thermal {
		polling-delay-passive = <0>;
		polling-delay = <1000>;

		thermal-sensors = <&thermal>;

		trips {
			cpu-crit {
				temperature	= <80000>;
				hysteresis	= <0>;
				type		= "critical";
			};
		};

		coefficients = <(-487)  410040>;

		cooling-maps {
		};
	};
};

thermal@7d5d2200 {
	compatible = "brcm,bcm2711-thermal";
	reg = <0x7d5d2200 0x2c>;
	interrupts = <GIC_SPI 137 IRQ_TYPE_LEVEL_HIGH>;
	interrupt-names = "tmon";
	clocks = <&clocks BCM2835_CLOCK_TSENS>;
	#thermal-sensor-cells = <0>;
};
```
